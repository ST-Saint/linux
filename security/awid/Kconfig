## security/awid/Kconfig
```kconfig
config AWID
    tristate "Build ARM Watchpoint Isolation Domain"
    depends on HAVE_HW_BREAKPOINT
    default m
    help
      This builds arm watchpoint isolation domain.
```
